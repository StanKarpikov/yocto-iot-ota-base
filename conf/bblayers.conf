## conf/bblayers.conf
```bitbake
# POKY_BBLAYERS_CONF_VERSION is increased each time build/conf/bblayers.conf
# changes incompatibly
POKY_BBLAYERS_CONF_VERSION = "2"

BBPATH = "${TOPDIR}"
BBFILES ?= ""

# Enable using:
# export JETSON_LAYERS_ENABLED=1
# export BB_ENV_PASSTHROUGH_ADDITIONS="JETSON_LAYERS_ENABLED"
JETSON_LAYERS_ENABLED ?= "1"
JETSON_LAYERS ?= " \
  ${TOPDIR}/meta-mender-community/meta-mender-tegra \
  ${TOPDIR}/tegra-demo-distro/layers/meta-virtualization \
  ${TOPDIR}/tegra-demo-distro/layers/meta-tegra-support \
  ${TOPDIR}/tegra-demo-distro/layers/meta-tegrademo \
  ${TOPDIR}/tegra-demo-distro/layers/meta-tegra \
  ${TOPDIR}/meta-jetson-mender-iot-base \
  "
BBMASK += "${@ ".*raspberrypi.*" if bb.utils.to_boolean(d.getVar('JETSON_LAYERS_ENABLED')) else "" }"

RASPBERRYPI_LAYERS_ENABLED ?= "0"
RASPBERRYPI_LAYERS ?= " \
  ${TOPDIR}/meta-raspberry \
  ${TOPDIR}/meta-raspberrypi-mender-iot-base \
  ${TOPDIR}/tegra-demo-distro/repos/poky/meta-poky \
  "
BBMASK += "${@ ".*jetson.*" if bb.utils.to_boolean(d.getVar('RASPBERRYPI_LAYERS_ENABLED')) else "" }"

BBLAYERS ?= " \
  ${TOPDIR}/tegra-demo-distro/layers/meta \
  ${TOPDIR}/tegra-demo-distro/layers/meta-oe \
  ${TOPDIR}/tegra-demo-distro/layers/meta-python \
  ${TOPDIR}/tegra-demo-distro/layers/meta-networking \
  ${TOPDIR}/tegra-demo-distro/layers/meta-filesystems \
  ${@bb.utils.contains('JETSON_LAYERS_ENABLED', '1', '${JETSON_LAYERS}', '', d)} \
  ${@bb.utils.contains('RASPBERRYPI_LAYERS_ENABLED', '1', '${RASPBERRYPI_LAYERS}', '', d)} \
  ${TOPDIR}/meta-mender-append \
  ${TOPDIR}/meta-mender/meta-mender-core \
  "
```

## conf/local.conf
```bitbake
#
# Where to place downloads
#
# During a first build the system will download many different source code tarballs
# from various upstream projects. This can take a while, particularly if your network
# connection is slow. These are all stored in DL_DIR. When wiping and rebuilding you
# can preserve this directory to speed up this part of subsequent builds. This directory
# is safe to share between multiple builds on the same machine too.
#
# The default is a downloads directory under TOPDIR which is the build directory.
#
DL_DIR ?= "${TOPDIR}/build/downloads"

#
# Where to place shared-state files
#
# BitBake has the capability to accelerate builds based on previously built output.
# This is done using "shared state" files which can be thought of as cache objects
# and this option determines where those files are placed.
#
# You can wipe out TMPDIR leaving this directory intact and the build would regenerate
# from these files if no changes were made to the configuration. If changes were made
# to the configuration, only shared state files where the state was still valid would
# be used (done using checksums).
#
# The default is a sstate-cache directory under TOPDIR.
#
SSTATE_DIR = "${TOPDIR}/build/sstate-cache"

#
# Where to place the build output
#
# This option specifies where the bulk of the building work should be done and
# where BitBake should place its temporary files and output. Keep in mind that
# this includes the extraction and compilation of many applications and the toolchain
# which can use Gigabytes of hard disk space.
#
# The default is a tmp directory under TOPDIR.
#
TMPDIR = "${TOPDIR}/build/tmp"

# Use a custom bootloader (optional)
# PREFERRED_PROVIDER_virtual/bootloader = "u-boot-custom"

#
# Machine Selection
#
# You need to select a specific machine to target the build with. There are a selection
# of emulated machines available which can boot and run in the QEMU emulator:
#
#MACHINE ?= "qemuarm"
#MACHINE ?= "qemuarm64"
#MACHINE ?= "qemumips"
#MACHINE ?= "qemumips64"
#MACHINE ?= "qemuppc"
#MACHINE ?= "qemux86"
#MACHINE ?= "qemux86-64"
#
# There are also the following hardware board target machines included for 
# demonstration purposes:
#
#MACHINE ?= "beaglebone-yocto"
#MACHINE ?= "genericarm64"
#MACHINE ?= "genericx86"
#MACHINE ?= "genericx86-64"
#
# This sets the default machine to be qemux86-64 if no other machine is selected:
# MACHINE = "raspberrypi4"
# MACHINE = "qemux86-64"
# MACHINE = "jetson-agx-orin-devkit"
MACHINE = "p3768-0000-p3767-0000"

DISTRO = "distro-custom"

# Adding this statement deletes the work directory used for building a recipe once the recipe is built.
INHERIT += "rm_work"

INIT_MANAGER = "systemd"
```

## meta-aws-iot-base/conf/layer.conf
```bitbake
BBPATH .= ":${LAYERDIR}"

BBFILES += "${LAYERDIR}/recipes-*/*/*.bb \
	${LAYERDIR}/recipes-*/*/*.bbappend"

BBFILE_COLLECTIONS += "meta-aws-iot-base"

BBFILE_PATTERN_meta-aws-iot-base = "^${LAYERDIR}/"

LAYERVERSION_meta-aws-iot-base = "1"
LAYERSERIES_COMPAT_meta-aws-iot-base = "scarthgap"
```

## meta-custom/conf/layer.conf
```bitbake
BBPATH .= ":${LAYERDIR}"

BBFILES += "${LAYERDIR}/recipes-*/*/*.bb \
	${LAYERDIR}/recipes-*/*/*.bbappend"

BBFILE_COLLECTIONS += "meta-custom"

BBFILE_PATTERN_meta-custom = "^${LAYERDIR}/"

LAYERVERSION_meta-custom = "1"
LAYERSERIES_COMPAT_meta-custom = "scarthgap styhead"
```

## meta-custom/conf/machine/jetson-orin-nx.conf
```bitbake
#@TYPE: Machine
#@NAME: Nvidia Jetson Orin NX
#@DESCRIPTION: Nvidia Jetson Orin NX

KERNEL_DEVICETREE = "tegra234-p3768-0000+p3767-0000-nv.dtb"

require conf/machine/include/orin-nx.inc
require conf/machine/include/devkit-wifi.inc
```

## meta-jetson-mender-iot-base/conf/layer.conf
```bitbake
BBPATH .= ":${LAYERDIR}"

BBFILES += "${LAYERDIR}/recipes-*/*/*.bb \
	${LAYERDIR}/recipes-*/*/*.bbappend"

BBFILE_COLLECTIONS += "meta-jetson-mender-iot-base"

BBFILE_PATTERN_meta-jetson-mender-iot-base = "^${LAYERDIR}/"

LAYERVERSION_meta-jetson-mender-iot-base = "1"
LAYERSERIES_COMPAT_meta-jetson-mender-iot-base = "scarthgap"
```

## meta-mender-append/conf/layer.conf
```bitbake
BBPATH .= ":${LAYERDIR}"

BBFILES += "${LAYERDIR}/recipes-*/*/*.bb \
	${LAYERDIR}/recipes-*/*/*.bbappend"

BBFILE_COLLECTIONS += "meta-mender-append"

BBFILE_PATTERN_meta-mender-append = "^${LAYERDIR}/"

LAYERVERSION_meta-mender-append = "1"
LAYERSERIES_COMPAT_meta-mender-append = "scarthgap"
```

## meta-raspberrypi-mender-iot-base/conf/layer.conf
```bitbake
BBPATH .= ":${LAYERDIR}"

BBFILES += "${LAYERDIR}/recipes-*/*/*.bb \
	${LAYERDIR}/recipes-*/*/*.bbappend"

BBFILE_COLLECTIONS += "meta-raspberrypi-mender-iot-base"

BBFILE_PATTERN_meta-raspberrypi-mender-iot-base = "^${LAYERDIR}/"

LAYERVERSION_meta-raspberrypi-mender-iot-base = "1"
LAYERSERIES_COMPAT_meta-raspberrypi-mender-iot-base = "scarthgap"
```
